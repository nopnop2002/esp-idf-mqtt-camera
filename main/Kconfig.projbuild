## main/Kconfig.projbuild
```kconfig
menu "Application Configuration"

	menu "WiFi Setting"

		config ESP_WIFI_SSID
			string "WiFi SSID"
			default "myssid"
			help
				SSID (network name) to connect to.

		config ESP_WIFI_PASSWORD
			string "WiFi Password"
			default "mypassword"
			help
				WiFi password (WPA or WPA2) to connect to.

		config ESP_MAXIMUM_RETRY
			int "Maximum retry"
			default 5
			help
				Set the Maximum retry to avoid station reconnecting to the AP unlimited when the AP is really inexistent.

		config MDNS_HOSTNAME
			string "mDNS Hostname"
			default "esp32-camera"
			help
				The mDNS host name used by the ESP32.

		config STATIC_IP
			bool "Enable Static IP Address"
			default false
			help
				Enable Static IP Address.

		config STATIC_IP_ADDRESS
			depends on STATIC_IP
			string "Static IP Address"
			default "192.168.10.100"
			help
				Static IP Address for Station.

		config STATIC_GW_ADDRESS
			depends on STATIC_IP
			string "Static GW Address"
			default "192.168.10.1"
			help
				Static GW Address for Station.

		config STATIC_NM_ADDRESS
			depends on STATIC_IP
			string "Static Netmask"
			default "255.255.255.0"
			help
				Static Netmask for Station.
	endmenu

	menu "MQTT Server Setting"

		config MQTT_BROKER
			string "MQTT Broker"
			default "esp32-broker.local"
			help
				Host name or IP address of the broker to connect to

		config PUB_TOPIC
			string "Publish Topic"
			default "/image/esp32cam"
			help
				Topic of publish

	endmenu

	choice BOARD
		bool "Select Board"
		default BOARD_ESP32CAM_AITHINKER
		help
			Select Board Type.

		config BOARD_ESP32_WROVER_FREENOVE
			bool "Freenove ESP32-WROVER CAM Board"
		config BOARD_ESP32S3_WROOM_FREENOVE
			bool "Freenove ESP32S3-WROOM CAM Board"
		config BOARD_CAMERA_MODEL_ESP_EYE
			bool "Espressif ESP-EYE"
		config BOARD_ESP32CAM_AITHINKER
			bool "AiThinker ESP32-CAM"
		config BOARD_CAMERA_MODEL_TTGO_T_JOURNAL
			bool "TTGO T-Journal ESP32 Camera"
		config BOARD_ESPS3_CAM_UICPAL
			bool "UICPAL ESPS3 CAM RE:1.0"
	endchoice

	choice FRAMESIZE
		bool "Select Frame Size"
		default FRAMESIZE_VGA
		help
			Select Picture Frame Size.

		config FRAMESIZE_240X240
			bool "Frame Size:240x240"
		config FRAMESIZE_QVGA
			bool "Frame Size:320x240"
		config FRAMESIZE_HVGA
			bool "Frame Size:480x320"
		config FRAMESIZE_VGA
			bool "Frame Size:640x480"
		config FRAMESIZE_SVGA
			bool "Frame Size:800x600"
		config FRAMESIZE_XGA
			bool "Frame Size:1024x768"
		config FRAMESIZE_HD
			bool "Frame Size:1280x720"
		config FRAMESIZE_SXGA
			bool "Frame Size:1280x1024"
		config FRAMESIZE_UXGA
			bool "Frame Size:1600x1200"
	endchoice

	menu "Select Shutter"
		choice SHUTTER_SELECT
			bool "Select Shutter"
			default SHUTTER_ENTER
			help
				Selecting the shutter method

			config SHUTTER_ENTER
				bool "Use Enter key"
			config SHUTTER_GPIO
				bool "Use GPIO"
			config SHUTTER_MQTT
				bool "Use MQTT Subscribe"

		endchoice

		config GPIO_INPUT
			depends on SHUTTER_GPIO
			int "Input GPIO number"
			range 4 34
			default 15
			help
				GPIO number (IOxx) to Button Input.

		choice GPIO_INITIAL
			depends on SHUTTER_GPIO
			prompt "GPIO Initial state"
			default GPIO_PULLDOWN
			help
				Select initial state of GPIO.

			config GPIO_PULLUP
				bool "GPIO_PULLUP"
				help
					The initial state of GPIO is Pull-UP.

			config GPIO_PULLDOWN
				bool "GPIO_PULLDOWN"
				help
					The initial state of GPIO is Pull-Down.

		endchoice

		config SUB_TOPIC
			depends on SHUTTER_MQTT
			string "Subscribe Topic"
			default "/take/picture"
			help
				Topic of subscribe

	endmenu

	config ENABLE_FLASH
		bool "Enable Flash Light"
		help
			Enable Flash Light.

	config GPIO_FLASH
		depends on ENABLE_FLASH
		int "Flash GPIO number"
		range 4 34
		default 4
		help
			GPIO number (IOxx) to Button Input.
			Some GPIOs are used for other purposes (flash connections, etc.) and cannot be used to Button.

endmenu
```

## sdkconfig.defaults
```kconfig
CONFIG_ESPTOOLPY_FLASHFREQ_80M=y
CONFIG_ESPTOOLPY_FLASHSIZE_4MB=y
CONFIG_ESP_MAIN_TASK_STACK_SIZE=8192

#
# ESP32-specific
#
CONFIG_ESP32_DEFAULT_CPU_FREQ_240=y
CONFIG_ESP32_DEFAULT_CPU_FREQ_MHZ=240
CONFIG_ESP32_SPIRAM_SUPPORT=y

#
# SPI RAM config
#
CONFIG_SPIRAM_BOOT_INIT=y
CONFIG_SPIRAM_IGNORE_NOTFOUND=
CONFIG_SPIRAM_USE_MEMMAP=
CONFIG_SPIRAM_USE_CAPS_ALLOC=y
CONFIG_SPIRAM_USE_MALLOC=
CONFIG_SPIRAM_TYPE_AUTO=y
CONFIG_SPIRAM_TYPE_ESPPSRAM32=
CONFIG_SPIRAM_TYPE_ESPPSRAM64=
CONFIG_SPIRAM_SIZE=-1
CONFIG_SPIRAM_SPEED_40M=
CONFIG_SPIRAM_SPEED_80M=y
CONFIG_SPIRAM_MEMTEST=y
CONFIG_SPIRAM_CACHE_WORKAROUND=y
CONFIG_SPIRAM_BANKSWITCH_ENABLE=y
CONFIG_SPIRAM_BANKSWITCH_RESERVE=8
CONFIG_WIFI_LWIP_ALLOCATION_FROM_SPIRAM_FIRST=
CONFIG_SPIRAM_ALLOW_BSS_SEG_EXTERNAL_MEMORY=
```
